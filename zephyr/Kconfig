## zephyr/Kconfig
```kconfig
# Baton-C Zephyr module
#
# Copyright (c) 2026 Anton Vynohradov
# SPDX-License-Identifier: Apache-2.0

menuconfig BATON
	bool "Baton-C deterministic single-wire UART bus"
	default y
	depends on DT_HAS_SYSTEMFROMSCRATCH_BATON_ENABLED
	depends on SERIAL && SERIAL_SUPPORT_INTERRUPT
	select UART_INTERRUPT_DRIVEN
	select GPIO if $(dt_compat_any_has_prop,systemfromscratch,baton,de-gpios)
	help
	  Master/slave messaging over one shared half-duplex UART line: the
	  master passes a token to each slave in turn, events are delivered
	  exactly once and in order, states deliver their latest value. One
	  node is created for every enabled "systemfromscratch,baton"
	  devicetree node. See https://antonvynohradov.github.io/Baton-C/

if BATON

config BATON_USER_CONFIG_DIR
	string "Folder with baton_user_config.h"
	default "baton"
	help
	  Folder that contains the application's baton_user_config.h (message
	  lists and buffer sizes, identical on every node of the bus). A
	  relative path is relative to the application source directory.

config BATON_INIT_PRIORITY
	int "Initialization priority"
	default 80
	help
	  Device initialization priority (POST_KERNEL). Must be after the UART
	  and, when de-gpios is used, the GPIO controller.

config BATON_THREAD_STACK_SIZE
	int "Protocol thread stack size"
	default 1024
	help
	  Stack of the protocol thread of each node. It runs
	  baton_node_process() and the application callbacks.

config BATON_THREAD_PRIORITY
	int "Protocol thread priority"
	default 5
	help
	  Priority of the protocol thread of each node. The thread sleeps
	  between steps, so a high priority costs little CPU and keeps the
	  bus timing tight.

config BATON_PROCESS_PERIOD_MS
	int "Longest time between two protocol steps (ms)"
	default 1
	range 1 10
	help
	  The protocol thread also wakes up on every received byte and on
	  every send or publish. 1 ms is the period the library recommends.

module = BATON
module-str = baton
source "subsys/logging/Kconfig.template.log_config"

endif # BATON
```

## zephyr/dts/bindings/baton/systemfromscratch,baton.yaml
```yaml
# Copyright (c) 2026 Anton Vynohradov
# SPDX-License-Identifier: Apache-2.0

description: |
  Baton-C node on a half-duplex UART bus (single wire, open drain or RS-485).

  The master passes a token (the baton) to every slave in turn, so only one
  node transmits at a time. The node is a child of the UART it uses; the bit
  rate is the current-speed of that UART. The UART must receive its own bytes
  (single-wire mode, open-drain TX tied to RX, or an RS-485 transceiver with
  the receiver always enabled): the echo ends every transmission and detects
  collisions.

  Example (slave 0x12 on a bus with master 0x01 and slaves 0x11, 0x12):

    &uart1 {
        status = "okay";
        current-speed = <9600>;

        baton0: baton {
            compatible = "systemfromscratch,baton";
            role = "slave";
            address = <0x12>;
            master-address = <0x01>;
            slave-addresses = [11 12];
        };
    };

  The topology (master-address and slave-addresses) and the message lists in
  baton_user_config.h must be identical on every node of the bus.

compatible: "systemfromscratch,baton"

include: base.yaml

on-bus: uart

properties:
  role:
    type: string
    required: true
    enum:
      - "master"
      - "slave"
    description: Role of this node. The order matches BATON_ROLE_MASTER/SLAVE.

  address:
    type: int
    required: true
    description: Bus address of this node (1..254). A master uses master-address.

  master-address:
    type: int
    required: true
    description: Bus address of the master.

  slave-addresses:
    type: uint8-array
    required: true
    description: Slave addresses in polling order, identical on every node.

  de-gpios:
    type: phandle-array
    description: |
      Optional RS-485 driver enable. Asserted when a frame starts and released
      when the echo of its last byte is received, that is, when the last stop
      bit has left the transceiver.

  slot-time-ms:
    type: int
    description: Longest time a slave owns the bus after a POLL (library default if absent).

  ack-timeout-ms:
    type: int
    description: Wait for an ACK after a DATA frame (library default if absent).

  max-retries:
    type: int
    description: DATA retransmissions per slot (library default if absent).

  tx-gap-ms:
    type: int
    description: Bus silence required before transmitting (library default if absent).

  inter-byte-timeout-ms:
    type: int
    description: Silence that aborts a partially received frame (library default if absent).

  cycle-period-ms:
    type: int
    description: Master only, shortest time between cycle starts (library default if absent).

  event-ttl-ms:
    type: int
    description: An undelivered event is dropped after this time (library default if absent).
```
